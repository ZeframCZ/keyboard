#include "zetor.dtsi"


&kscan1 {
    col-gpios
        = <&pro_micro 14 GPIO_ACTIVE_HIGH>

        ;
    row-gpios
        = <&pro_micro 16 (GPIO_ACTIVE_HIGH | GPIO_PULL_DOWN)>

        ;
};


&kscan2 {
    col-gpios
        = <&pro_micro 8 GPIO_ACTIVE_HIGH>

        ;
    row-gpios
        = <&pro_micro 7 (GPIO_ACTIVE_HIGH | GPIO_PULL_DOWN)>

        ;
};