## boards/shields/myshield/Kconfig.shield
```kconfig
config SHIELD_MYSHIELD_LEFT
    def_bool $(shields_list_contains,myshield_left)

config SHIELD_MYSHIELD_RIGHT
    def_bool $(shields_list_contains,myshield_right)
```

## boards/shields/zetor/Kconfig.defconfig
```kconfig
if SHIELD_ZETOR_DONGLE

config ZMK_KEYBOARD_NAME
    default "zetor dongle"

config ZMK_SPLIT_BLE_ROLE_CENTRAL
	default y

config ZMK_USB
	default y

endif

if SHIELD_ZETOR_LEFT || SHIELD_ZETOR_RIGHT || SHIELD_ZETOR_DONGLE

config ZMK_SPLIT
    default y


config ZMK_BLE
	default y

endif
```

## boards/shields/zetor/Kconfig.shield
```kconfig
config SHIELD_ZETOR_LEFT
    def_bool $(shields_list_contains,zetor_left)

config SHIELD_ZETOR_RIGHT
    def_bool $(shields_list_contains,zetor_right)

config SHIELD_ZETOR_DONGLE
    def_bool $(shields_list_contains,zetor_dongle)
```
